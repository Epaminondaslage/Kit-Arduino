#include <IRremote.h> //INCLUSÃO DE BIBLIOTECA
 
IRsend irsend; // VARIÁVEL RESPONSÁVEL PELO MÉTODO DE ENVIO DO SINAL IR
int tamanho = 68; // TAMANHO DA LINHA RAW(68 BLOCOS)
int frequencia = 32; // FREQUÊNCIA DO SINAL IR(32KHz)

// BOTÃO LIGA / DESLIGA
unsigned int LD[68] = {}; // COLE A LINHA RAW CORRESPONDENTE DENTRO DAS CHAVES
// BOTÃO EJECT
//unsigned int EJ[68] = {}; // UTILIZADO PARA APARELHOS DE SOM
// BOTÃO MUTE
unsigned int MT[68] = {}; // COLE A LINHA RAW CORRESPONDENTE DENTRO DAS CHAVES
// BOTÃO PLAY / PAUSE
unsigned int PP[68] = {}; // COLE A LINHA RAW CORRESPONDENTE DENTRO DAS CHAVES
// BOTÃO VOLTAR
unsigned int VT[68] = {}; // COLE A LINHA RAW CORRESPONDENTE DENTRO DAS CHAVES
// BOTÃO ADIANTAR
unsigned int AT[68] = {}; // COLE A LINHA RAW CORRESPONDENTE DENTRO DAS CHAVES
// BOTÃO UM
unsigned int UM[68] = {}; // COLE A LINHA RAW CORRESPONDENTE DENTRO DAS CHAVES
// BOTÃO DOIS
unsigned int DOIS[68] = {}; // COLE A LINHA RAW CORRESPONDENTE DENTRO DAS CHAVES
// BOTÃO TRES
unsigned int TRES[68] = {}; // COLE A LINHA RAW CORRESPONDENTE DENTRO DAS CHAVES
// BOTÃO QUATRO
unsigned int QUATRO[68] = {}; // COLE A LINHA RAW CORRESPONDENTE DENTRO DAS CHAVES
// BOTÃO CINCO
unsigned int CINCO[68] = {}; // COLE A LINHA RAW CORRESPONDENTE DENTRO DAS CHAVES
// BOTÃO SEIS
unsigned int SEIS[68] = {}; // COLE A LINHA RAW CORRESPONDENTE DENTRO DAS CHAVES
// BOTÃO SETE
unsigned int SETE[68] = {}; // COLE A LINHA RAW CORRESPONDENTE DENTRO DAS CHAVES
// BOTÃO OITO
unsigned int OITO[68] = {}; // COLE A LINHA RAW CORRESPONDENTE DENTRO DAS CHAVES
// BOTÃO NOVE
unsigned int NOVE[68] = {}; // COLE A LINHA RAW CORRESPONDENTE DENTRO DAS CHAVES
// BOTÃO AUMENTAR VOLUME
unsigned int VMAIS[68] = {}; // COLE A LINHA RAW CORRESPONDENTE DENTRO DAS CHAVES
// BOTÃO ZERO
unsigned int ZERO[68] = {}; // COLE A LINHA RAW CORRESPONDENTE DENTRO DAS CHAVES
// BOTÃO AVANÇAR CANAIS
unsigned int CMAIS[68] = {}; // COLE A LINHA RAW CORRESPONDENTE DENTRO DAS CHAVES
// BOTÃO ENTRADAS
unsigned int ENTRADAS[68] = {}; // COLE A LINHA RAW CORRESPONDENTE DENTRO DAS CHAVES
// BOTÃO DIMINUIR VOLUME
unsigned int VMENOS[68] = {}; // COLE A LINHA RAW CORRESPONDENTE DENTRO DAS CHAVES
// BOTÃO OK
unsigned int OK[68] = {}; // COLE A LINHA RAW CORRESPONDENTE DENTRO DAS CHAVES
// BOTÃO VOLTAR CANAIS
unsigned int CMENOS[68] = {}; // COLE A LINHA RAW CORRESPONDENTE DENTRO DAS CHAVES
 
void setup(){
  Serial.begin(9600); //INICIALIZA A PORTA SERIAL
}
void loop(){
    
    char c = Serial.read(); //VARIÁVEL RESPONSÁVEL POR RECEBER O CARACTER DIGITADO NA JANELA SERIAL
    
    if (c == 'a'){ //SE CARACTER DIGITADO FOR IGUAL A "a", FAZ
        irsend.sendRaw(LD,tamanho,frequencia);  // PARÂMETROS NECESSÁRIOS PARA ENVIO DO SINAL IR
        delay(50); // TEMPO(EM MILISEGUNDOS) DE INTERVALO ENTRE UM COMANDO E OUTRO
    }
    if (c == 'b'){ //SE CARACTER DIGITADO FOR IGUAL A "b", FAZ
        irsend.sendRaw(MT,tamanho,frequencia); // PARÂMETROS NECESSÁRIOS PARA ENVIO DO SINAL IR
        delay(50); // TEMPO(EM MILISEGUNDOS) DE INTERVALO ENTRE UM COMANDO E OUTRO
    }
    if (c == 'c'){ //SE CARACTER DIGITADO FOR IGUAL A "c", FAZ
        irsend.sendRaw(PP,tamanho,frequencia); // PARÂMETROS NECESSÁRIOS PARA ENVIO DO SINAL IR
        delay(50); // TEMPO(EM MILISEGUNDOS) DE INTERVALO ENTRE UM COMANDO E OUTRO
    }
    if (c == 'd'){ //SE CARACTER DIGITADO FOR IGUAL A "d", FAZ
        irsend.sendRaw(VT,tamanho,frequencia); // PARÂMETROS NECESSÁRIOS PARA ENVIO DO SINAL IR
        delay(50); // TEMPO(EM MILISEGUNDOS) DE INTERVALO ENTRE UM COMANDO E OUTRO
    }
    if (c == 'e'){ //SE CARACTER DIGITADO FOR IGUAL A "e", FAZ
        irsend.sendRaw(AT,tamanho,frequencia); // PARÂMETROS NECESSÁRIOS PARA ENVIO DO SINAL IR
        delay(50); // TEMPO(EM MILISEGUNDOS) DE INTERVALO ENTRE UM COMANDO E OUTRO
    }
    if (c == 'f'){ //SE CARACTER DIGITADO FOR IGUAL A "f", FAZ
        irsend.sendRaw(UM,tamanho,frequencia); // PARÂMETROS NECESSÁRIOS PARA ENVIO DO SINAL IR
        delay(50); // TEMPO(EM MILISEGUNDOS) DE INTERVALO ENTRE UM COMANDO E OUTRO
    }
    if (c == 'g'){ //SE CARACTER DIGITADO FOR IGUAL A "g", FAZ
        irsend.sendRaw(DOIS,tamanho,frequencia); // PARÂMETROS NECESSÁRIOS PARA ENVIO DO SINAL IR
        delay(50); // TEMPO(EM MILISEGUNDOS) DE INTERVALO ENTRE UM COMANDO E OUTRO
    }
    if (c == 'h'){ //SE CARACTER DIGITADO FOR IGUAL A "h", FAZ
        irsend.sendRaw(TRES,tamanho,frequencia); // PARÂMETROS NECESSÁRIOS PARA ENVIO DO SINAL IR
        delay(50); // TEMPO(EM MILISEGUNDOS) DE INTERVALO ENTRE UM COMANDO E OUTRO
    }
    if (c == 'i'){ //SE CARACTER DIGITADO FOR IGUAL A "i", FAZ
        irsend.sendRaw(QUATRO,tamanho,frequencia); // PARÂMETROS NECESSÁRIOS PARA ENVIO DO SINAL IR
        delay(50); // TEMPO(EM MILISEGUNDOS) DE INTERVALO ENTRE UM COMANDO E OUTRO
    }
    if (c == 'j'){ //SE CARACTER DIGITADO FOR IGUAL A "j", FAZ
        irsend.sendRaw(CINCO,tamanho,frequencia); // PARÂMETROS NECESSÁRIOS PARA ENVIO DO SINAL IR
      delay(50); // TEMPO(EM MILISEGUNDOS) DE INTERVALO ENTRE UM COMANDO E OUTRO
    }
    if (c == 'k'){ //SE CARACTER DIGITADO FOR IGUAL A "k", FAZ
        irsend.sendRaw(SEIS,tamanho,frequencia); // PARÂMETROS NECESSÁRIOS PARA ENVIO DO SINAL IR
        delay(50); // TEMPO(EM MILISEGUNDOS) DE INTERVALO ENTRE UM COMANDO E OUTRO
    }
    if (c == 'l'){ //SE CARACTER DIGITADO FOR IGUAL A "l", FAZ
        irsend.sendRaw(SETE,tamanho,frequencia); // PARÂMETROS NECESSÁRIOS PARA ENVIO DO SINAL IR
        delay(50); // TEMPO(EM MILISEGUNDOS) DE INTERVALO ENTRE UM COMANDO E OUTRO
    }
    if (c == 'm'){ //SE CARACTER DIGITADO FOR IGUAL A "m", FAZ
        irsend.sendRaw(OITO,tamanho,frequencia); // PARÂMETROS NECESSÁRIOS PARA ENVIO DO SINAL IR
        delay(50); // TEMPO(EM MILISEGUNDOS) DE INTERVALO ENTRE UM COMANDO E OUTRO
    }
    if (c == 'n'){ //SE CARACTER DIGITADO FOR IGUAL A "n", FAZ
        irsend.sendRaw(NOVE,tamanho,frequencia); // PARÂMETROS NECESSÁRIOS PARA ENVIO DO SINAL IR
      delay(50); // TEMPO(EM MILISEGUNDOS) DE INTERVALO ENTRE UM COMANDO E OUTRO
    }
    if (c == 'o'){ //SE CARACTER DIGITADO FOR IGUAL A "o", FAZ
        irsend.sendRaw(VMAIS,tamanho,frequencia); // PARÂMETROS NECESSÁRIOS PARA ENVIO DO SINAL IR
        delay(50); // TEMPO(EM MILISEGUNDOS) DE INTERVALO ENTRE UM COMANDO E OUTRO
    }
    if (c == 'p'){ //SE CARACTER DIGITADO FOR IGUAL A "p", FAZ
        irsend.sendRaw(ZERO,tamanho,frequencia); // PARÂMETROS NECESSÁRIOS PARA ENVIO DO SINAL IR
        delay(50); // TEMPO(EM MILISEGUNDOS) DE INTERVALO ENTRE UM COMANDO E OUTRO
    }
    if (c == 'q'){ //SE CARACTER DIGITADO FOR IGUAL A "q", FAZ
        irsend.sendRaw(CMAIS,tamanho,frequencia); // PARÂMETROS NECESSÁRIOS PARA ENVIO DO SINAL IR
        delay(50); // TEMPO(EM MILISEGUNDOS) DE INTERVALO ENTRE UM COMANDO E OUTRO
    }
    if (c == 'r'){ //SE CARACTER DIGITADO FOR IGUAL A "r", FAZ
        irsend.sendRaw(ENTRADAS,tamanho,frequencia); // PARÂMETROS NECESSÁRIOS PARA ENVIO DO SINAL IR
        delay(50); // TEMPO(EM MILISEGUNDOS) DE INTERVALO ENTRE UM COMANDO E OUTRO
    }
    if (c == 's'){ //SE CARACTER DIGITADO FOR IGUAL A "s", FAZ
        irsend.sendRaw(VMENOS,tamanho,frequencia); // PARÂMETROS NECESSÁRIOS PARA ENVIO DO SINAL IR
        delay(50); // TEMPO(EM MILISEGUNDOS) DE INTERVALO ENTRE UM COMANDO E OUTRO
    }
    if (c == 't'){ //SE CARACTER DIGITADO FOR IGUAL A "t", FAZ
        irsend.sendRaw(OK,tamanho,frequencia); // PARÂMETROS NECESSÁRIOS PARA ENVIO DO SINAL IR
        delay(50); // TEMPO(EM MILISEGUNDOS) DE INTERVALO ENTRE UM COMANDO E OUTRO
    }
    if (c == 'u'){ //SE CARACTER DIGITADO FOR IGUAL A "u", FAZ
        irsend.sendRaw(CMENOS,tamanho,frequencia); // PARÂMETROS NECESSÁRIOS PARA ENVIO DO SINAL IR
      delay(50); // TEMPO(EM MILISEGUNDOS) DE INTERVALO ENTRE UM COMANDO E OUTRO
    }
}
